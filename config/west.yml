## config/west.yml
```yaml
manifest:
  remotes:
    - name: joelspadin
      url-base: https://github.com/joelspadin
  projects:
    - name: zmk
      remote: joelspadin
      revision: send-string-behavior
      import: app/west.yml
  self:
    path: config
```
